/* Dual-Core Hart Launch (RP2350 RISC-V, Hazard3 RV32IMAC).
 * Generated by gen_rv32.py - do not hand-edit (edit the generator).
 * Flash base 0x10000000 (entry via bootrom), SRAM to 0x20082000.
 */
    .text
    .globl _start
    .align 2
_start:
    lui sp, 0x20082            # SP = top of SRAM
    lui t0, 0x40070            # UART0 base
    addi t1, zero, 0x301
    sw t1, 0x30(t0)            # UARTEN|TXE|RXE

.Lr1: auipc a0, %pcrel_hi(.Ls1)
    addi a0, a0, %pcrel_lo(.Lr1)
    jal ra, print_string
    lui t0, 0x20080
    sw zero, 0(t0)
    hart1_site:
    auipc t0, %pcrel_hi(hart1_entry)
    addi t0, t0, %pcrel_lo(hart1_site)
    lui t1, 0xD0000
    sw t0, 0x1C0(t1)
    lui t0, 0x20081
    sw t0, 0x1C4(t1)
    sw zero, 0x1C8(t1)
    addi t0, zero, 1
    sw t0, 0x1CC(t1)
.Lr2: auipc a0, %pcrel_hi(.Ls2)
    addi a0, a0, %pcrel_lo(.Lr2)
    jal ra, print_string
    lui s0, 0x20080
    lui t2, 0x1313
    addi t2, t2, -768
    dc_poll:
    lw t0, 0(s0)
    bnez t0, dc_done
    addi t2, t2, -1
    bnez t2, dc_poll
.Lr3: auipc a0, %pcrel_hi(.Ls3)
    addi a0, a0, %pcrel_lo(.Lr3)
    jal ra, print_string
    j dc_end
    dc_done:
.Lr4: auipc a0, %pcrel_hi(.Ls4)
    addi a0, a0, %pcrel_lo(.Lr4)
    jal ra, print_string
    dc_end:
.Lr5: auipc a0, %pcrel_hi(.Ls5)
    addi a0, a0, %pcrel_lo(.Lr5)
    jal ra, print_string
    j dc_halt
    dc_halt:
    j dc_halt
.align 2
    hart1_entry:
    lui sp, 0x20081
    lui t2, 0x31
    addi t2, t2, -704
    hart1_delay:
    addi t2, t2, -1
    bnez t2, hart1_delay
.Lr6: auipc a0, %pcrel_hi(.Ls6)
    addi a0, a0, %pcrel_lo(.Lr6)
    jal ra, print_string
    lui t0, 0x20080
    addi t1, zero, 1
    sw t1, 0(t0)
    hart1_done:
    j hart1_done

halt:
    j halt


print_string:                # a0 = ptr
    addi sp, sp, -16
    sw ra, 12(sp)
    sw t0, 8(sp)
    sw t1, 4(sp)
ps_loop:
    lbu t1, 0(a0)
    beqz t1, ps_done
    lui t0, 0x40070
    sw t1, 0(t0)
    addi a0, a0, 1
    j ps_loop
ps_done:
    lw ra, 12(sp)
    lw t0, 8(sp)
    lw t1, 4(sp)
    addi sp, sp, 16
    ret

print_hex32:                 # a0 = word: 8 hex digits + newline
    addi sp, sp, -16
    sw ra, 12(sp)
    sw t1, 8(sp)
    sw t2, 4(sp)
    addi t2, zero, 8
    mv t1, a0
hex_digit:
    srli a0, t1, 28
    slli t1, t1, 4
    addi t0, zero, 10
    bgeu a0, t0, hex_alpha
    addi a0, a0, 0x30
    j hex_out
hex_alpha:
    addi a0, a0, 0x37
hex_out:
    lui t0, 0x40070
    sw a0, 0(t0)
    addi t2, t2, -1
    bnez t2, hex_digit
    addi a0, zero, 0x0A
    lui t0, 0x40070
    sw a0, 0(t0)
    lw ra, 12(sp)
    lw t1, 8(sp)
    lw t2, 4(sp)
    addi sp, sp, 16
    ret

uart_getc:                   # -> a0 = byte (blocks)
    lui t0, 0x40070
ug_wait:
    lw t1, 0x18(t0)
    andi t1, t1, 0x10
    bnez t1, ug_wait
    lw a0, 0(t0)
    andi a0, a0, 0xFF
    ret


    .section .rodata
    .align 2
.Ls1: .asciz "Dual-Core Test Starting (Hart 0 + Hart 1)\n"
.Ls2: .asciz "Hart 0 launched Hart 1\n"
.Ls3: .asciz "FAIL: Hart 1 never signalled\n"
.Ls4: .asciz "Hart 1 signalled, both harts ran\n"
.Ls5: .asciz "Dual-Core Test Complete!\n"
.Ls6: .asciz "Hello from Hart 1\n"
