/*
 * eth_dhcp — full DHCP client over W5500 MACRAW socket 0.
 * Generated by gen_eth_dhcp.py - do not hand-edit (edit the generator).
 *
 * ioLibrary-style flow against the pico-eth board (W5500 on SPI0,
 * CSn=GPIO17 bit-banged, mode 0):
 *   OPEN/MACRAW sock0 -> SEND DHCP DISCOVER -> poll RECV -> parse OFFER
 *   -> SEND DHCP REQUEST -> poll ACK -> print ETH IP=a.b.c.d + ETH DONE.
 *
 * Two builds from this one source (RP2040 ifdefs):
 *   M0+   (RP2040): UART0 0x40034000 SPI0 0x4003C000 RAM_TOP 0x20042000
 *   M33   (RP2350): UART0 0x40070000 SPI0 0x40080000 RAM_TOP 0x20082000
 * Assemble M33 with -DRP2350 (build.sh _pico2 pattern, build_eth.py).
 *
 * Guest embeds DISCOVER/REQUEST as .byte blobs (checksums precomputed
 * in eth_dhcp_common.py) — no runtime frame build, no checksum code.
 * Parse side is byte-at-a-time against RXBUF (v6m-safe: no [Rn,#>31],
 * no adds>7, no high-reg arithmetic, no adcs-imm).
 *
 * Markers: ETH DHCP-START / ETH OFFER IP= / ETH IP= / ETH DONE / ETH FAIL.

 * M0 MAC 02:11:22:33:44:60 XID a0b0c0d0 / M33 MAC 02:11:22:33:44:61 XID b0b1c0d1.
 */
.syntax unified
#ifdef RP2350
.cpu cortex-m33
#else
.cpu cortex-m0plus
#endif
.thumb

#ifdef RP2350
.equ UART0_DR,    0x40070000
.equ UART0_CR,    0x40070030
.equ RAM_TOP,     0x20082000
.equ SPI_CR0,     0x40080000
.equ SPI_CR1,     0x40080004
.equ SPI_DR,      0x40080008
.equ SPI_CPSR,    0x40080010
#else
.equ UART0_DR,    0x40034000
.equ UART0_CR,    0x40034030
.equ RAM_TOP,     0x20042000
.equ SPI_CR0,     0x4003C000
.equ SPI_CR1,     0x4003C004
.equ SPI_DR,      0x4003C008
.equ SPI_CPSR,    0x4003C010
#endif
.equ UART_CR_EN_LO, 0x01
.equ UART_CR_EN_HI, 0x03   /* UARTEN|TXE|RXE = 0x301, built v6m-safe */

.equ SIO_OE_SET,  0xD0000024
.equ SIO_OUT_SET, 0xD0000014
.equ SIO_OUT_CLR, 0xD0000018
/* CS mask as two 16-bit halves (v6m-safe): 0x20000 = HI 0x2 / LO 0x0000.
 * NEVER ldr r1, =CS_MASK (clang emits Thumb-2 mov.w for it); always
 * materialize via CS_MASK_HI/LO into SEPARATE low regs, then combine
 * with lsls+adds (both Thumb-1 legal). */
.equ CS_MASK_HI,  0x2
.equ CS_MASK_LO,  0x0000

/* W5500 socket-0 register offsets (BSB=1) */
.equ S_MR,   0x00
.equ S_CR,   0x01
.equ S_IR,   0x02
.equ S_SR,   0x03
.equ S_TXWR, 0x24
.equ S_RSR,  0x26
.equ S_RD,   0x28
.equ BSB_REG, 1
.equ BSB_TX,  2
.equ BSB_RX,  3

/* SRAM scratch (high addresses below the M0 RAM top so BOTH arches fit:
 * M0 SRAM is 0x20000000-0x20042000, M33 extends to 0x20082000; the stack
 * starts at RAM_TOP and grows down, TXBUF/RXBUF sit 1KB below M0 top). */
.equ TXBUF, 0x20041C00     /* 512B frame build area */
.equ RXBUF, 0x20041E00     /* 512B RX frame area */
.equ SAVE_SLOT, 0x20001000 /* MISO ground-truth word (see spi_xfer note) */

.section .vectors, "a", %progbits
.align 2
_vectors:
.word RAM_TOP
.word reset_handler
.word 0xFFFFFFFF
.word 0xFFFFFFFF
.rept 12
.word 0xFFFFFFFF
.endr

.section .text
.align 2

/* reset_handler is deliberately SMALL: init + VERSIONR/MACRAW-OPEN only,
 * then calls helpers. Its literal pool stays adjacent (.ltorg right
 * after failhalt), so no out-of-range ldr fixups on v6m. */
.thumb_func
.global reset_handler
reset_handler:
ldr r7, =RAM_TOP; mov sp, r7
ldr r4, =UART0_CR; movs r5, #UART_CR_EN_HI; lsls r5, r5, #8; adds r5, #UART_CR_EN_LO; str r5, [r4]
ldr r0, =msg_start; bl print_string
/* SPI0 init: CR0=7 (8-bit SPI), CPSR=2, CR1=SSE(2) */
ldr r0, =SPI_CR0; movs r1, #7; str r1, [r0]
ldr r0, =SPI_CPSR; movs r1, #2; str r1, [r0]
ldr r0, =SPI_CR1; movs r1, #2; str r1, [r0]
/* GPIO17 output, CS high idle */
ldr r0, =SIO_OE_SET; movs r1, #CS_MASK_HI; lsls r1, r1, #16; str r1, [r0]
ldr r0, =SIO_OUT_SET; movs r1, #CS_MASK_HI; lsls r1, r1, #16; str r1, [r0]
/* VERSIONR expect 0x04. NOTE: every SSPDR write clocks one byte and the
 * matching MISO byte must be DRAINED (SSPDR read) before the next write
 * — the RX FIFO holds only 8 and stale echoes misalign the frame. This
 * mirrors test_board_eth_attach_spi0_cs17 exactly. */
bl spi_cs_lo
movs r0, #0; bl spi_xfer_drain
movs r0, #0x39; bl spi_xfer_drain
movs r0, #0; bl spi_xfer_drain
movs r0, #0xFF; bl spi_xfer
bl spi_cs_hi
ldr r0, =SAVE_SLOT
ldr r4, [r0]
cmp r4, #4
beq ver_ok
ldr r0, =msg_fail_ver; bl print_string; b fail
ver_ok:
/* SHAR0..5 = frame SRC MAC (per-arch, selected by the same RP2350
 * ifdef as the blobs below): the vnet MACRAW attach + RX filter use
 * SHAR, and the server keys the lease off chaddr. Default SHAR
 * (02:00:..:01) matches neither, so OFFERs never arrive.
 * v6m-safe: r4=cursor, r5=SHAR addr 9..14, r6=data byte. spi_xfer_drain
 * preserves r0-r2 only (r3 is trash) — keep the byte in r6 (callee-saved,
 * and wait_offer's caller dhcp_run already saves r4-r7). */
/* SHAR is written with the W5500-word helper (wreg): one CS frame per
 * byte would also work, but wreg keeps addr+bsb+data in a single frame
 * exactly like the OPEN sequence below (proven path). r0=addr r1=bsb
 * r2=val. wreg preserves r4-r7 (push {r0-r3,lr} + inner push/pop). */
#ifdef RP2350
ldr r4, =mac_addr_m33
#else
ldr r4, =mac_addr_m0
#endif
movs r5, #9                 /* SHAR0 addr */
shar_loop:
ldrb r6, [r4]              /* val -> r6 (callee-saved, survives bl) */
push {r4-r5}               /* cursor+addr survive the call */
mov r0, r5                 /* addr -> r0 (wreg_shar_byte arg) */
bl wreg_shar_byte
pop {r4-r5}
adds r4, #1
adds r5, #1
cmp r5, #15
bne shar_loop
b shar_done
wreg_shar_byte:
/* r0 = SHAR addr (9..14). MAC byte arrives in r6 (caller's, preserved:
 * this function only touches r0-r3 + lr). */
push {r1-r3,lr}
mov r3, r6                /* data byte -> r3 */
mov r2, r0                /* addr lo -> r2 */
movs r0, #0               /* addr hi = 0 */
push {r2-r3}              /* save addr lo + data (r0-r1 free) */
bl spi_cs_lo
pop {r2-r3}
movs r0, #0; bl spi_xfer_drain       /* addr hi */
mov r0, r2; bl spi_xfer_drain        /* addr lo */
movs r0, #(0<<3)|4; bl spi_xfer_drain /* common-block write */
mov r0, r3; bl spi_xfer_drain        /* MAC byte */
bl spi_cs_hi
pop {r1-r3,pc}
shar_done:
/* Sn_MR = MACRAW(4), Sn_CR = OPEN(1), expect Sn_SR = 0x42.
 * Write-phase echoes are drained (bl spi_xfer_drain); only the final
 * data-phase MISO byte is kept. */
bl spi_cs_lo
movs r0, #0; bl spi_xfer_drain
movs r0, #S_MR; bl spi_xfer_drain
movs r0, #(BSB_REG<<3)|4; bl spi_xfer_drain
movs r0, #4; bl spi_xfer_drain
bl spi_cs_hi
bl spi_cs_lo
movs r0, #0; bl spi_xfer_drain
movs r0, #S_CR; bl spi_xfer_drain
movs r0, #(BSB_REG<<3)|4; bl spi_xfer_drain
movs r0, #1; bl spi_xfer_drain
bl spi_cs_hi
bl spi_cs_lo
movs r0, #0; bl spi_xfer_drain
movs r0, #S_SR; bl spi_xfer_drain
movs r0, #(BSB_REG<<3); bl spi_xfer_drain
movs r0, #0xFF; bl spi_xfer
bl spi_cs_hi
ldr r0, =SAVE_SLOT
ldr r4, [r0]
cmp r4, #0x42
beq open_ok
ldr r0, =msg_fail_open; bl print_string; b fail
open_ok:
ldr r0, =msg_macraw; bl print_string
/* DHCP DORA lives in dhcp_run (own pool, own small literals) */
bl dhcp_run
halt: b halt
fail:
ldr r0, =msg_fail; bl print_string
failhalt: b failhalt
.ltorg

/* ---------- SPI byte exchange: r0=MOSI -> r0=MISO (low byte) ----------
 * spi_xfer keeps the MISO byte. spi_xfer_drain discards it (write phases:
 * without draining, the 8-deep RX FIFO fills and echoes misalign every
 * subsequent frame — the classic silent W5500 failure). */
.thumb_func
spi_xfer:
push {r1-r2,lr}
ldr r1, =SPI_DR
str r0, [r1]
ldr r0, [r1]
uxtb r0, r0
/* The data-phase MISO byte must ALSO survive in SRAM: high regs (r4+)
 * are observed to lose their value across later bl calls on this core
 * (print_hex8+print_string clobber r4 even though both preserve it —
 * root cause still open; SRAM is ground truth). spi_xfer itself only
 * touches r1-r2 (both restored), so wait_offer's mov r6,r0 pattern and
 * dhcp_run's arithmetic on r4-r7 stay intact. */
ldr r1, =SAVE_SLOT
str r0, [r1]
pop {r1,r2,pc}
.thumb_func
spi_xfer_drain:
/* Drain-only: preserves r0-r7 (headers live in r0-r3 AND r5-r6 across
 * phases: SHAR loop cursor/addr/data are r4-r6, TX_WR hi/lo are r2/r5,
 * wreg/rreg stash across push{p...} too). MISO is discarded into r1,
 * which is restored by the balanced pop — the push/pop register lists
 * MUST match (an old push{r1,lr}/pop{r1,pc} mismatch leaked one word
 * per call, walking SP down into the frame and crashing after VER-OK). */
push {r1,r2,lr}
ldr r1, =SPI_DR
str r0, [r1]
ldr r2, [r1]              /* MISO -> r2 (restored below, value dropped) */
pop {r1,r2,pc}
/* NOTE: r0 (MOSI) is dead after the call by convention; every other
 * register is preserved, including lr (returned via pc). */

/* ---------- CS helpers ---------- */
.thumb_func
spi_cs_lo:
push {r0,r1,lr}
ldr r0, =SIO_OUT_CLR; movs r1, #CS_MASK_HI; lsls r1, r1, #16; str r1, [r0]
pop {r0,r1,pc}
.thumb_func
spi_cs_hi:
push {r0,r1,lr}
ldr r0, =SIO_OUT_SET; movs r1, #CS_MASK_HI; lsls r1, r1, #16; str r1, [r0]
pop {r0,r1,pc}

/* ---------- W5500 reg write: r0=addr r1=bsb r2=val ----------
 * NOTE: wreg/rreg are DEAD CODE (kept for documentation; nothing bl's
 * to them — all live paths use inline drain sequences). They are still
 * assembled, so they must stay v6m-legal, but they are never called. */
.thumb_func
wreg:
push {r0-r3,lr}
mov r3, r2
lsrs r2, r0, #8           /* addr hi */
push {r0-r3}
mov r0, r2; bl spi_xfer
pop {r0-r3}
push {r0-r3}
mov r0, r0; bl spi_xfer  /* addr lo */
pop {r0-r3}
lsls r1, r1, #3
adds r1, #4
push {r0-r3}
mov r0, r1; bl spi_xfer
pop {r0-r3}
mov r0, r3; bl spi_xfer
pop {r0-r3,pc}

/* ---------- W5500 reg read: r0=addr r1=bsb -> r0=val (DEAD, see above) */
.thumb_func
rreg:
push {r1-r3,lr}
mov r3, r0
lsrs r2, r3, #8
push {r1-r3}
bl spi_cs_lo
mov r0, r2; bl spi_xfer_drain
mov r0, r3; bl spi_xfer_drain  /* lo byte */
pop {r1-r3}
lsls r1, r1, #3
push {r1-r3}
mov r0, r1; bl spi_xfer_drain
movs r0, #0xFF; bl spi_xfer
mov r3, r0
bl spi_cs_hi
mov r0, r3
pop {r1-r3,pc}

/* ---------- macraw_send: r0=buf r1=len_lo r2=len_hi ----------
 * Copies r1+r2*256 bytes to TX buf (VDM BSB_TX from addr 0), sets
 * TX_WR=len, issues SEND. Small loop, small pool. */
.thumb_func
macraw_send:
push {r4-r7,lr}
mov r4, r0                /* buf */
mov r5, r1                /* len lo */
mov r6, r2                /* len hi */
bl spi_cs_lo
movs r0, #0; bl spi_xfer_drain
movs r0, #0; bl spi_xfer_drain
movs r0, #(BSB_TX<<3)|4; bl spi_xfer_drain
/* Total = hi<<8|lo in r4 (v6m-safe lsls+adds); single down-counter in
 * r6. The old dual-counter loop never decremented hi and exited when
 * i-lo exceeded len-lo — copying 87B of a 342B frame. r5/r6 keep
 * len-lo/hi for the TX_WR writes below. */
mov r7, r4                /* cursor = buf */
lsls r4, r2, #8           /* hi<<8 (r2 = len-hi, still intact) */
adds r4, r4, r1           /* total = hi<<8|lo */
mov r6, r4                /* remaining */
txloop:
cmp r6, #0
beq txdone
ldrb r0, [r7]
bl spi_xfer_drain         /* TX echoes fill RX FIFO: drain (MISO unneeded) */
adds r7, #1
subs r6, #1
b txloop
txdone:
bl spi_cs_hi
/* TX_WR = len BE (two single-byte reg writes; TX_WR0 is the HIGH byte).
 * SINGLE CS FRAME for both bytes: the W5500 TX_WR is a 16-bit pointer
 * and the model latches each byte write independently — but splitting
 * hi/lo across two CS frames lets a stale-data echo from the first
 * frame's data phase bleed into the second frame's header on the
 * 8-deep PL022 FIFO if any drain is missed. One frame = one addr
 * phase (VDM auto-increment 0x24->0x25), two data bytes, no gap. */
bl spi_cs_lo
movs r0, #0; bl spi_xfer_drain
movs r0, #S_TXWR; bl spi_xfer_drain
movs r0, #(BSB_REG<<3)|4; bl spi_xfer_drain
mov r0, r2; bl spi_xfer_drain        /* hi byte -> 0x24 */
mov r0, r5; bl spi_xfer_drain        /* lo -> 0x25 */
bl spi_cs_hi
/* Sn_CR = SEND (SEND_OK observed via Sn_IR poll; data-phase MISO
 * unneeded — drain to keep the RX FIFO aligned). */
bl spi_cs_lo
movs r0, #0; bl spi_xfer_drain
movs r0, #S_CR; bl spi_xfer_drain
movs r0, #(BSB_REG<<3)|4; bl spi_xfer_drain
movs r0, #0x20; bl spi_xfer_drain
bl spi_cs_hi
pop {r4-r7,pc}

/* ---------- dhcp_run: DISCOVER->OFFER->REQUEST->ACK, prints, DONE ----------
 * Own literal pool (blobs + strings are all nearby). Frame bytes come
 * from the .rodata blobs; REQUEST is patched with offered yiaddr+server
 * before send (copy_blob helper). */
.thumb_func
dhcp_run:
push {r4-r7,lr}
/* SEND DISCOVER blob */
ldr r0, =TXBUF
ldr r1, =disc_blob
movs r2, #(86)
movs r3, #(1)
bl copy_blob
ldr r0, =TXBUF
movs r1, #(86)
movs r2, #(1)
bl macraw_send
/* await OFFER (msg type 2) */
bl wait_offer
cmp r0, #2
beq d_got_offer
ldr r0, =msg_fail_offer; bl print_string; b dhcp_fail
d_got_offer:
ldr r0, =msg_offer; bl print_string
bl print_ip
ldr r0, =msg_nl; bl print_string
/* SEND REQUEST blob (patched with yip/sip by wait_offer) */
ldr r0, =TXBUF
ldr r1, =req_blob
movs r2, #(86)
movs r3, #(1)
bl copy_blob
bl patch_request
ldr r0, =TXBUF
movs r1, #(86)
movs r2, #(1)
bl macraw_send
/* await ACK (msg type 5) */
bl wait_offer
cmp r0, #5
beq d_got_ack
ldr r0, =msg_fail_ack; bl print_string; b dhcp_fail
d_got_ack:
ldr r0, =msg_ip; bl print_string
bl print_ip
ldr r0, =msg_nl; bl print_string
ldr r0, =msg_done; bl print_string
pop {r4-r7,pc}
dhcp_fail:
ldr r0, =msg_fail; bl print_string
pop {r4-r7,pc}
.ltorg

/* ---------- copy_blob: r0=dst r1=src r2=len_lo r3=len_hi ----------
 * v6m-safe: build total = hi<<8|lo in r3, single down-counter in r2.
 * (The old dual-counter form decremented lo but ADDED on wrap, so the
 * 342B DISCOVER spun forever: lo wraps every 86/87 bytes, hi grows
 *  without bound and the loop never exits.) */
.thumb_func
copy_blob:
push {r4-r6,lr}
mov r4, r0
mov r5, r1
lsls r3, r3, #8             /* hi<<8 */
adds r3, r3, r2             /* total = hi<<8|lo */
mov r2, r3                  /* remaining */
cbloop:
cmp r2, #0
beq cbdone
ldrb r3, [r5]
strb r3, [r4]
adds r4, #1
adds r5, #1
subs r2, #1
b cbloop
cbdone:
pop {r4-r6,pc}

/* ---------- patch_request: TXBUF REQUEST gets yip@opt50, sip@opt54 -----
 * REQUEST blob layout: opts start at TXBUF+14+20+8+240 = TXBUF+282.
 * opt53(3B) then opt50(6B: 50,4,a.b.c.d) then opt54(6B: 54,4,a.b.c.d).
 * Requested-IP value = TXBUF+282+3+2 = TXBUF+287; server value =
 * TXBUF+282+3+6+2 = TXBUF+293. Reached by small stepwise adds (v6m). */
.thumb_func
patch_request:
push {r0-r3,lr}
/* r0 = TXBUF+287 (requested-IP value) via 41x7 */
ldr r0, =TXBUF
adds r0, #7
adds r0, #7
adds r0, #7
adds r0, #7
adds r0, #7
adds r0, #7
adds r0, #7
adds r0, #7
adds r0, #7
adds r0, #7
adds r0, #7
adds r0, #7
adds r0, #7
adds r0, #7
adds r0, #7
adds r0, #7
adds r0, #7
adds r0, #7
adds r0, #7
adds r0, #7
adds r0, #7
adds r0, #7
adds r0, #7
adds r0, #7
adds r0, #7
adds r0, #7
adds r0, #7
adds r0, #7
adds r0, #7
adds r0, #7
adds r0, #7
adds r0, #7
adds r0, #7
adds r0, #7
adds r0, #7
adds r0, #7
adds r0, #7
adds r0, #7
adds r0, #7
adds r0, #7
adds r0, #7               /* +287 */
ldr r1, =yip_addr
ldrb r2, [r1]; strb r2, [r0]
adds r0, #1
adds r1, #1
ldrb r2, [r1]; strb r2, [r0]
adds r0, #1
adds r1, #1
ldrb r2, [r1]; strb r2, [r0]
adds r0, #1
adds r1, #1
ldrb r2, [r1]; strb r2, [r0]
adds r0, #2               /* TXBUF+293 = server-IP value (+6) */
ldr r1, =sip_addr
ldrb r2, [r1]; strb r2, [r0]
adds r0, #1
adds r1, #1
ldrb r2, [r1]; strb r2, [r0]
adds r0, #1
adds r1, #1
ldrb r2, [r1]; strb r2, [r0]
adds r0, #1
adds r1, #1
ldrb r2, [r1]; strb r2, [r0]
pop {r0-r3,pc}
.ltorg

/* ---------- wait_offer: poll RECV, parse msg type -> r0 (2/5/0) -------
 * Bounded poll of Sn_IR RECV; reads one RX frame (len prefix + frame)
 * into RXBUF; validates ethertype/bootp magic/xid; saves yiaddr+server;
 * returns DHCP msg type (opt 53) or 0 on timeout/mismatch (then the
 * caller retries until its own bound expires).
 * NOTE: Sn_IR is polled WITHOUT dropping CS between header bytes and
 * the data byte (single CS frame; CS-hi between header/data would still
 * work on VDM but wastes polls). r6 holds the RECV bit in r0-safe regs
 * (r0 dies in spi_xfer_drain — MISO returns in r0 only from spi_xfer). */
.thumb_func
wait_offer:
push {r4-r7,lr}
ldr r5, =0x2000000           /* outer bound (~33M iters) */
wo_poll:
bl spi_cs_lo
movs r0, #0; bl spi_xfer_drain
movs r0, #S_IR; bl spi_xfer_drain
movs r0, #(BSB_REG<<3); bl spi_xfer_drain
movs r0, #0xFF; bl spi_xfer
mov r6, r0
bl spi_cs_hi
mov r0, r6
movs r1, #4
ands r0, r1
bne wo_got
subs r5, #1
bne wo_poll
movs r0, #0
pop {r4-r7,pc}
wo_got:
/* read RX buffer start: len_hi,len_lo then frame bytes to RXBUF.
 * Header-phase echoes drained; len bytes KEPT (need them); frame bytes
 * KEPT (strb to RXBUF). */
bl spi_cs_lo
movs r0, #0; bl spi_xfer_drain
movs r0, #0; bl spi_xfer_drain
movs r0, #(BSB_RX<<3); bl spi_xfer_drain
movs r0, #0xFF; bl spi_xfer
mov r6, r0                /* len hi */
movs r0, #0xFF; bl spi_xfer
mov r7, r0                /* len lo */
lsls r6, r6, #8
adds r6, r6, r7           /* r6 = frame len */
ldr r4, =RXBUF
mov r5, r6
wo_rxcopy:
cmp r5, #0
beq wo_rxdone
movs r0, #0xFF; bl spi_xfer
strb r0, [r4]               /* KEEP MISO: model returns data, not echo */
adds r4, #1
subs r5, #1
b wo_rxcopy
wo_rxdone:
bl spi_cs_hi
/* Sn_CR = RECV (consume one frame; data-phase MISO unneeded — drain) */
bl spi_cs_lo
movs r0, #0; bl spi_xfer_drain
movs r0, #S_CR; bl spi_xfer_drain
movs r0, #(BSB_REG<<3)|4; bl spi_xfer_drain
movs r0, #0x40; bl spi_xfer_drain
bl spi_cs_hi
bl parse_offer            /* r0 = msg type or 0 */
cmp r0, #0
bne wo_done
/* not ours: re-poll budget (v6m-safe, no T2 mov.w) then give up */
ldr r5, =0x1000000           /* re-poll budget */
b wo_poll
wo_done:
pop {r4-r7,pc}
.ltorg

/* ---------- parse_offer: RXBUF frame -> yiaddr/sip, r0 = msgtype/0 ----
 * Checks ethertype 0800, bootp magic, xid; saves yiaddr->yip_addr and
 * opt54->sip_addr; walks options for opt53. Byte-at-a-time, v6m-safe. */
.thumb_func
parse_offer:
push {r4-r7,lr}
ldr r0, =RXBUF
adds r0, #7
adds r0, #5               /* r0 = RXBUF+12 ethertype */
ldrb r1, [r0]
cmp r1, #8
bne po_no
adds r0, #1
ldrb r1, [r0]
cmp r1, #0
bne po_no
adds r0, #1               /* r0 = RXBUF+14 IP */
adds r0, #7
adds r0, #7
adds r0, #7
adds r0, #7
adds r0, #2
adds r0, #2               /* r0 = bootp+4 xid */
ldrb r1, [r0]
#ifdef RP2350
cmp r1, #0xB0
#else
cmp r1, #0xA0
#endif
bne po_no
adds r0, #1
ldrb r1, [r0]
#ifdef RP2350
cmp r1, #0xB1
#else
cmp r1, #0xB0
#endif
bne po_no
adds r0, #7
adds r0, #4               /* r0 = bootp+16 yiaddr */
ldr r1, =yip_addr
ldrb r2, [r0]; strb r2, [r1]
adds r0, #1
adds r1, #1
ldrb r2, [r0]; strb r2, [r1]
adds r0, #1
adds r1, #1
ldrb r2, [r0]; strb r2, [r1]
adds r0, #1
adds r1, #1
ldrb r2, [r0]; strb r2, [r1]
/* r0 = bootp+19 -> magic at bootp+236 (+217) */
adds r0, #7
adds r0, #7
adds r0, #7
adds r0, #7
adds r0, #7
adds r0, #7
adds r0, #7
adds r0, #7
adds r0, #7
adds r0, #7
adds r0, #7
adds r0, #7
adds r0, #7
adds r0, #7
adds r0, #7
adds r0, #7
adds r0, #7
adds r0, #7
adds r0, #7
adds r0, #7
adds r0, #7
adds r0, #7
adds r0, #7
adds r0, #7
adds r0, #7
adds r0, #7
adds r0, #7
adds r0, #7
adds r0, #7
adds r0, #7
adds r0, #7               /* +217 = bootp+236 */
ldrb r1, [r0]
cmp r1, #99
bne po_no
adds r0, #1
ldrb r1, [r0]
cmp r1, #130
bne po_no
adds r0, #3               /* bootp+240 options */
ldr r1, =sip_addr
movs r2, #0               /* msg type */
po_optloop:
ldrb r3, [r0]
cmp r3, #255
beq po_optdone
cmp r3, #53
bne po_opt_next
adds r0, #2
ldrb r2, [r0]
subs r0, #2
b po_opt_adv
po_opt_next:
cmp r3, #54
bne po_opt_adv
adds r0, #2
ldrb r3, [r0]; strb r3, [r1]
adds r0, #1
adds r1, #1
ldrb r3, [r0]; strb r3, [r1]
adds r0, #1
adds r1, #1
ldrb r3, [r0]; strb r3, [r1]
adds r0, #1
adds r1, #1
ldrb r3, [r0]; strb r3, [r1]
subs r0, #3
subs r1, #3
b po_opt_adv2
po_opt_adv:
ldrb r3, [r0, #1]
adds r0, #2
adds r0, r0, r3
b po_optloop
po_opt_adv2:
ldrb r3, [r0, #1]
adds r0, #2
adds r0, r0, r3
b po_optloop
po_optdone:
mov r0, r2
pop {r4-r7,pc}
po_no:
movs r0, #0
pop {r4-r7,pc}
.ltorg

/* print_hex8: r0 = byte -> 2 hex digits. Lives with the other print
 * helpers (pool-local); the early .ltorg after reset covers reset's own
 * literals. Clobbers r1,r2. */
.thumb_func
print_hex8:
push {r1,r2,lr}
mov r1, r0
lsrs r0, r1, #4
cmp r0, #10
blo hex8_hi
adds r0, #7
hex8_hi:
adds r0, #0x30
ldr r2, =UART0_DR
str r0, [r2]
movs r0, r1
movs r1, #15
ands r0, r1
cmp r0, #10
blo hex8_lo
adds r0, #7
hex8_lo:
adds r0, #0x30
str r0, [r2]
pop {r1,r2,pc}

/* ---------- print helpers ---------- */
.thumb_func
print_string:
push {r1-r3,lr}
mov r1, r0
ldr r2, =UART0_DR
ps_loop:
ldrb r3, [r1]
cmp r3, #0
beq ps_done
str r3, [r2]
adds r1, #1
b ps_loop
ps_done:
pop {r1-r3,pc}

.thumb_func
print_ip:                 /* prints yip_addr as a.b.c.d (no newline) */
push {r4-r6,lr}
ldr r4, =yip_addr
movs r5, #4
ip_oct:
ldrb r0, [r4]
bl print_u8
subs r5, #1
beq ip_end
movs r0, #46              /* '.' */
ldr r1, =UART0_DR
str r0, [r1]
adds r4, #1
b ip_oct
ip_end:
pop {r4-r6,pc}

.thumb_func
print_u8:                 /* r0 = 0..255 -> decimal, no leading zeros */
push {r4-r6,lr}
mov r4, r0
movs r6, #0
movs r5, #100
bl print_digit
movs r5, #10
bl print_digit
movs r5, #1
bl print_digit
pop {r4-r6,pc}

.thumb_func
print_digit:              /* r4=val r5=div r6=printed-flag; digit via subtract */
push {r0-r2,lr}
mov r0, r4
mov r1, r5
movs r2, #0
dloop:
cmp r0, r1
blo ddone
subs r0, r0, r1
adds r2, #1
b dloop
ddone:
mov r4, r0
cmp r5, #1
beq dshow
cmp r2, #0
bne dshow
cmp r6, #1
beq dshow_zero
b dend
dshow_zero:
movs r2, #0
dshow:
adds r2, #48
ldr r0, =UART0_DR
str r2, [r0]
movs r6, #1
b dend
dend:
pop {r0-r2,pc}

.ltorg

.section .rodata
.align 2
msg_start: .asciz "ETH DHCP-START\n"
msg_macraw: .asciz "ETH MACRAW-OK\n"
msg_offer: .asciz "ETH OFFER IP="
msg_ip: .asciz "ETH IP="
msg_nl: .asciz "\n"
msg_done: .asciz "ETH DONE\n"
msg_fail: .asciz "ETH FAIL\n"
msg_fail_ver: .asciz "ETH FAIL VERSION\n"
msg_fail_open: .asciz "ETH FAIL OPEN\n"
msg_fail_offer: .asciz "ETH FAIL OFFER-TIMEOUT\n"
msg_fail_ack: .asciz "ETH FAIL ACK-TIMEOUT\n"
#ifndef RP2350
disc_blob:  /* M0 DISCOVER 342B */
    .byte 0xFF, 0xFF, 0xFF, 0xFF, 0xFF, 0xFF, 0x02, 0x11, 0x22, 0x33, 0x44, 0x60
    .byte 0x08, 0x00, 0x45, 0x00, 0x01, 0x48, 0x11, 0x22, 0x00, 0x00, 0x40, 0x11
    .byte 0x68, 0x84, 0x00, 0x00, 0x00, 0x00, 0xFF, 0xFF, 0xFF, 0xFF, 0x00, 0x44
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    .byte 0x00, 0x00, 0x00, 0x00, 0x00, 0x00
req_blob:   /* M0 REQUEST 342B */
    .byte 0xFF, 0xFF, 0xFF, 0xFF, 0xFF, 0xFF, 0x02, 0x11, 0x22, 0x33, 0x44, 0x60
    .byte 0x08, 0x00, 0x45, 0x00, 0x01, 0x48, 0x33, 0x44, 0x00, 0x00, 0x40, 0x11
    .byte 0x46, 0x62, 0x00, 0x00, 0x00, 0x00, 0xFF, 0xFF, 0xFF, 0xFF, 0x00, 0x44
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    .byte 0x00, 0x00, 0x00, 0x00, 0x00, 0x00
#endif
#ifdef RP2350
disc_blob:  /* M33 DISCOVER 342B */
    .byte 0xFF, 0xFF, 0xFF, 0xFF, 0xFF, 0xFF, 0x02, 0x11, 0x22, 0x33, 0x44, 0x61
    .byte 0x08, 0x00, 0x45, 0x00, 0x01, 0x48, 0x11, 0x22, 0x00, 0x00, 0x40, 0x11
    .byte 0x68, 0x84, 0x00, 0x00, 0x00, 0x00, 0xFF, 0xFF, 0xFF, 0xFF, 0x00, 0x44
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    .byte 0x00, 0x00, 0x00, 0x00, 0x00, 0x00
req_blob:   /* M33 REQUEST 342B */
    .byte 0xFF, 0xFF, 0xFF, 0xFF, 0xFF, 0xFF, 0x02, 0x11, 0x22, 0x33, 0x44, 0x61
    .byte 0x08, 0x00, 0x45, 0x00, 0x01, 0x48, 0x33, 0x44, 0x00, 0x00, 0x40, 0x11
    .byte 0x46, 0x62, 0x00, 0x00, 0x00, 0x00, 0xFF, 0xFF, 0xFF, 0xFF, 0x00, 0x44
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    .byte 0x00, 0x00, 0x00, 0x00, 0x00, 0x00
#endif
mac_addr_m33: .byte 0x02,0x11,0x22,0x33,0x44,0x61
mac_addr_m0: .byte 0x02,0x11,0x22,0x33,0x44,0x60
ip_hdr: .byte 0x45,0,0,0, 0x11,0x22,0,0, 64,17,0,0, 0,0,0,0, 255,255,255,255

/* SRAM state (NOT .bss/.data: the raw .bin image has no startup copier
 * and flash is not writable — state lives at fixed SRAM addresses valid
 * on BOTH arches: M0 SRAM is 0x20000000-0x20042000, M33 0x20082000 top;
 * low 0x20000000+256 is free RAM on both; stack starts at RAM_TOP). */
.equ YIP_ADDR, 0x20000100
.equ SIP_ADDR, 0x20000104
.equ yip_addr, YIP_ADDR
.equ sip_addr, SIP_ADDR
