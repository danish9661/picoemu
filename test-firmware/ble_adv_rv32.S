/* BLE ADV Test (RP2350 RISC-V, Hazard3 RV32IMAC).
 * Generated by gen_rv32.py - do not hand-edit (edit the generator).
 * Flash base 0x10000000 (entry via bootrom), SRAM to 0x20082000.
 */
    .text
    .globl _start
    .align 2
_start:
    lui sp, 0x20082            # SP = top of SRAM
    lui t0, 0x40070            # UART0 base
    addi t1, zero, 0x301
    sw t1, 0x30(t0)            # UARTEN|TXE|RXE

.Lr1: auipc a0, %pcrel_hi(.Ls1)
    addi a0, a0, %pcrel_lo(.Lr1)
    jal ra, print_string
    lui s0, 0x50400
    lui s1, 0x50400
    addi s1, s1, 16
    lui t1, 0x7
    addi t1, t1, 1024
    sw t1, 0xDC(s0)
    addi t1, zero, 272
    sw t1, 0x00(s0)
    addi t1, zero, 31
    sw t1, 0x10(s0)
    sw t1, 0x10(s0)
    lui t1, 0xa0044
    sw t1, 0x10(s0)
    lw t1, 0x20(s0)
    addi t1, zero, 272
    sw t1, 0x00(s0)
    addi t1, zero, 31
    sw t1, 0x10(s0)
    sw t1, 0x10(s0)
    lui t1, 0xa0044
    sw t1, 0x10(s0)
    lw t1, 0x20(s0)
    lui s2, 0x20081
    lui s3, 0x20081
    addi s3, s3, 0x400
    addi s5, zero, 0
    addi s7, zero, 0
    lui a0, 0x18000
    jal ra, ba_window
    lui a0, 0x1
    addi a0, a0, -900
    jal ra, ba_rd32
    mv s4, a0
.Lr2: auipc a0, %pcrel_hi(.Ls2)
    addi a0, a0, %pcrel_lo(.Lr2)
    jal ra, print_string
    mv a0, s4
    jal ra, print_hex32
    lui a0, 0x1
    addi a0, a0, -664
    jal ra, ba_rd32
    mv s4, a0
.Lr3: auipc a0, %pcrel_hi(.Ls3)
    addi a0, a0, %pcrel_lo(.Lr3)
    jal ra, print_string
    mv a0, s4
    jal ra, print_hex32
    lui a0, 0x1
    addi a0, a0, -660
    jal ra, ba_rd32
    ori a1, a0, 1
    lui a0, 0x1
    addi a0, a0, -660
    jal ra, ba_wr32
    lui a0, 0x1c0
    jal ra, ba_window
    lui a0, 0x2
    mv a1, zero
    jal ra, ba_wr32
    lui a0, 0x2
    addi a0, a0, 4
    mv a1, zero
    jal ra, ba_wr32
    lui a0, 0x2
    addi a0, a0, 8
    mv a1, zero
    jal ra, ba_wr32
    lui a0, 0x2
    addi a0, a0, 12
    mv a1, zero
    jal ra, ba_wr32
.Lr4: auipc a0, %pcrel_hi(.Ls4)
    addi a0, a0, %pcrel_lo(.Lr4)
    jal ra, print_string
    lui a0, 0x1
    addi a0, a0, -1021
    mv a1, zero
    mv a2, zero
    jal ra, ba_hci
    jal ra, ba_wait_cc
    bnez a0, ba_fail
.Lr5: auipc a0, %pcrel_hi(.Ls5)
    addi a0, a0, %pcrel_lo(.Lr5)
    jal ra, print_string
    mv t6, s3
    addi t6, t6, 512
    lui t1, 0x400
    addi t1, t1, 64
    sw t1, 0(t6)
    addi t1, zero, 0
    sw t1, 4(t6)
    addi t1, zero, 0
    sw t1, 8(t6)
    addi t1, zero, 1792
    sw t1, 12(t6)
    mv t6, s3
    addi t6, t6, 512
    mv a1, t6
    lui a0, 0x2
    addi a0, a0, 6
    addi a2, zero, 15
    jal ra, ba_hci
    jal ra, ba_wait_cc
    bnez a0, ba_fail
    mv t6, s3
    addi t6, t6, 512
    lui t1, 0x6010
    addi t1, t1, 522
    sw t1, 0(t6)
    lui t1, 0x52421
    addi t1, t1, -1786
    sw t1, 4(t6)
    lui t1, 0x323
    addi t1, t1, 854
    sw t1, 8(t6)
    addi t1, zero, 0
    sw t1, 12(t6)
    addi t1, zero, 0
    sw t1, 16(t6)
    addi t1, zero, 0
    sw t1, 20(t6)
    addi t1, zero, 0
    sw t1, 24(t6)
    addi t1, zero, 0
    sw t1, 28(t6)
    mv t6, s3
    addi t6, t6, 512
    mv a1, t6
    lui a0, 0x2
    addi a0, a0, 8
    addi a2, zero, 32
    jal ra, ba_hci
    jal ra, ba_wait_cc
    bnez a0, ba_fail
    mv t6, s3
    addi t6, t6, 512
    sb zero, 0(t6)
    addi t0, zero, 1
    sb t0, 0(t6)
    mv t6, s3
    addi t6, t6, 512
    mv a1, t6
    lui a0, 0x2
    addi a0, a0, 10
    addi a2, zero, 1
    jal ra, ba_hci
    jal ra, ba_wait_cc
    bnez a0, ba_fail
.Lr6: auipc a0, %pcrel_hi(.Ls6)
    addi a0, a0, %pcrel_lo(.Lr6)
    jal ra, print_string
    mv t6, s3
    addi t6, t6, 512
    lui t1, 0x10001
    addi t1, t1, 1
    sw t1, 0(t6)
    addi t1, zero, 0
    sw t1, 4(t6)
    mv t6, s3
    addi t6, t6, 512
    mv a1, t6
    lui a0, 0x2
    addi a0, a0, 11
    addi a2, zero, 7
    jal ra, ba_hci
    jal ra, ba_wait_cc
    bnez a0, ba_fail
    mv t6, s3
    addi t6, t6, 512
    addi t1, zero, 1
    sw t1, 0(t6)
    mv t6, s3
    addi t6, t6, 512
    mv a1, t6
    lui a0, 0x2
    addi a0, a0, 12
    addi a2, zero, 2
    jal ra, ba_hci
    jal ra, ba_wait_cc
    bnez a0, ba_fail
.Lr7: auipc a0, %pcrel_hi(.Ls7)
    addi a0, a0, %pcrel_lo(.Lr7)
    jal ra, print_string
    lui s4, 0x3d1
    addi s4, s4, -1792
    ba_scan:
    jal ra, ba_poll_b2h
    beqz a0, ba_scan_next
    jal ra, ba_read_ev
    lbu t0, 0(s2)
    addi t1, zero, 62
    bne t0, t1, ba_scan_next
    lbu t0, 2(s2)
    addi t1, zero, 2
    bne t0, t1, ba_scan_next
.Lr8: auipc a0, %pcrel_hi(.Ls8)
    addi a0, a0, %pcrel_lo(.Lr8)
    jal ra, print_string
    j ba_halt
    ba_scan_next:
    addi s4, s4, -1
    bnez s4, ba_scan
.Lr9: auipc a0, %pcrel_hi(.Ls9)
    addi a0, a0, %pcrel_lo(.Lr9)
    jal ra, print_string
    ba_halt:
    j ba_halt
    ba_fail:
.Lr10: auipc a0, %pcrel_hi(.Ls10)
    addi a0, a0, %pcrel_lo(.Lr10)
    jal ra, print_string
    j ba_fail
    ba_bswap:
    andi t0, a0, 0xFF
    slli t0, t0, 24
    srli t1, a0, 24
    or t0, t0, t1
    srli t1, a0, 8
    andi t1, t1, 0xFF
    slli t1, t1, 16
    or t0, t0, t1
    srli t1, a0, 16
    andi t1, t1, 0xFF
    slli t1, t1, 8
    or a0, t0, t1
    jalr zero, 0(ra)
    ba_pio_wr_pre:
    addi t0, zero, 0x110
    sw t0, 0x00(s0)
    addi t0, zero, 0x1FF
    sw t0, 0(s1)
    sw zero, 0(s1)
    jalr zero, 0(ra)
    ba_cmd:
    addi sp, sp, -16
    sw ra, 12(sp)
    jal ra, ba_bswap
    sw a0, 0(s1)
    lw ra, 12(sp)
    addi sp, sp, 16
    jalr zero, 0(ra)
    ba_wdata:
    addi sp, sp, -16
    sw ra, 12(sp)
    jal ra, ba_bswap
    sw a0, 0(s1)
    lw ra, 12(sp)
    addi sp, sp, 16
    jalr zero, 0(ra)
    ba_window:
    addi sp, sp, -16
    sw ra, 12(sp)
    sw s8, 8(sp)
    mv s8, a0
    srli a1, s8, 8
    andi a1, a1, 0xFF
    jal ra, ba_pio_wr_pre
    lui t0, 0xd8005
    addi t0, t0, 4
    mv a0, t0
    jal ra, ba_cmd
    mv a0, a1
    jal ra, ba_wdata
    srli a1, s8, 16
    andi a1, a1, 0xFF
    jal ra, ba_pio_wr_pre
    lui t0, 0xd8006
    addi t0, t0, -2044
    mv a0, t0
    jal ra, ba_cmd
    mv a0, a1
    jal ra, ba_wdata
    srli a1, s8, 24
    jal ra, ba_pio_wr_pre
    lui t0, 0xd8006
    addi t0, t0, 4
    mv a0, t0
    jal ra, ba_cmd
    mv a0, a1
    jal ra, ba_wdata
    lw s8, 8(sp)
    lw ra, 12(sp)
    addi sp, sp, 16
    jalr zero, 0(ra)
    ba_wr32:
    addi sp, sp, -16
    sw ra, 12(sp)
    sw a1, 4(sp)
    slli t0, a0, 11
    lui t1, 0xd0000
    addi t1, t1, 4
    or t0, t0, t1
    sw t0, 8(sp)
    jal ra, ba_pio_wr_pre
    lw a0, 8(sp)
    jal ra, ba_cmd
    lw a0, 4(sp)
    jal ra, ba_wdata
    lw ra, 12(sp)
    addi sp, sp, 16
    jalr zero, 0(ra)
    ba_rd32:
    addi sp, sp, -16
    sw ra, 12(sp)
    slli t0, a0, 11
    lui t1, 0x50000
    addi t1, t1, 4
    or t0, t0, t1
    sw t0, 8(sp)
    jal ra, ba_pio_wr_pre
    lw a0, 8(sp)
    jal ra, ba_cmd
    lui t2, 0x5
    addi t2, t2, -480
    ba_r32_poll:
    lw t1, 0x04(s0)
    andi t1, t1, 0x100
    beqz t1, ba_r32_got
    addi t2, t2, -1
    bnez t2, ba_r32_poll
    addi a0, zero, 0
    lw ra, 12(sp)
    addi sp, sp, 16
    jalr zero, 0(ra)
    ba_r32_got:
    lw t1, 0x20(s0)
    lw t1, 0x20(s0)
    lw t1, 0x20(s0)
    lw t1, 0x20(s0)
    lw a0, 0x20(s0)
    jal ra, ba_bswap
    lw ra, 12(sp)
    addi sp, sp, 16
    jalr zero, 0(ra)
    ba_wr_bulk:
    addi sp, sp, -32
    sw ra, 28(sp)
    sw a1, 16(sp)
    sw a2, 12(sp)
    slli t0, a0, 11
    lui t1, 0xd0000
    or t0, t0, t1
    or t0, t0, a2
    sw t0, 4(sp)
    jal ra, ba_pio_wr_pre
    lw t0, 4(sp)
    mv a0, t0
    jal ra, ba_cmd
    lw t3, 16(sp)
    lw t2, 12(sp)
    srli t2, t2, 2
    ba_wb_loop:
    beqz t2, ba_wb_done
    lw a0, 0(t3)
    jal ra, ba_wdata
    addi t3, t3, 4
    addi t2, t2, -1
    j ba_wb_loop
    ba_wb_done:
    lw ra, 28(sp)
    addi sp, sp, 32
    jalr zero, 0(ra)
    ba_rd_bulk:
    addi sp, sp, -32
    sw ra, 28(sp)
    sw a1, 16(sp)
    sw a2, 12(sp)
    slli t0, a0, 11
    lui t1, 0x50000
    or t0, t0, t1
    or t0, t0, a2
    sw t0, 8(sp)
    jal ra, ba_pio_wr_pre
    lw a0, 8(sp)
    jal ra, ba_cmd
    lui t2, 0xc
    addi t2, t2, 848
    ba_rb_poll:
    lw t1, 0x04(s0)
    andi t1, t1, 0x100
    beqz t1, ba_rb_got
    addi t2, t2, -1
    bnez t2, ba_rb_poll
    j ba_rb_done
    ba_rb_got:
    lw t1, 0x20(s0)
    lw t1, 0x20(s0)
    lw t1, 0x20(s0)
    lw t1, 0x20(s0)
    lw t3, 16(sp)
    lw t2, 12(sp)
    srli t2, t2, 2
    ba_rb_loop:
    beqz t2, ba_rb_done
    lw t1, 0x20(s0)
    mv a0, t1
    jal ra, ba_bswap
    sw a0, 0(t3)
    addi t3, t3, 4
    addi t2, t2, -1
    j ba_rb_loop
    ba_rb_done:
    lw ra, 28(sp)
    addi sp, sp, 32
    jalr zero, 0(ra)
    ba_hci:
    addi sp, sp, -32
    sw ra, 28(sp)
    sw a0, 24(sp)
    sw a1, 20(sp)
    sw a2, 16(sp)
    mv t6, s3
    addi t0, a2, 3
    sb t0, 0(t6)
    srli t0, t0, 8
    sb t0, 1(t6)
    sb zero, 2(t6)
    addi t0, zero, 1
    sb t0, 3(t6)
    lw t0, 24(sp)
    sb t0, 4(t6)
    srli t0, t0, 8
    sb t0, 5(t6)
    lw t0, 16(sp)
    sb t0, 6(t6)
    lw t3, 20(sp)
    addi t4, t6, 7
    lw t2, 16(sp)
    ba_hci_copy:
    beqz t2, ba_hci_pad
    lbu t0, 0(t3)
    sb t0, 0(t4)
    addi t3, t3, 1
    addi t4, t4, 1
    addi t2, t2, -1
    j ba_hci_copy
    ba_hci_pad:
    lw t0, 16(sp)
    addi t0, t0, 7
    addi t1, t0, 3
    srli t1, t1, 2
    slli t1, t1, 2
    sub t2, t1, t0
    mv t0, t1
    ba_hci_padloop:
    beqz t2, ba_hci_send
    sb zero, 0(t4)
    addi t4, t4, 1
    addi t2, t2, -1
    j ba_hci_padloop
    ba_hci_send:
    sw t0, 12(sp)
    mv a0, s7
    mv a1, s3
    mv a2, t0
    jal ra, ba_wr_bulk
    lw t0, 12(sp)
    add t0, s7, t0
    mv s7, t0
    slli s7, s7, 20
    srli s7, s7, 20
    mv a1, s7
    li a0, 0x2000
    jal ra, ba_wr32
    lw ra, 28(sp)
    addi sp, sp, 32
    jalr zero, 0(ra)
    ba_poll_b2h:
    addi sp, sp, -16
    sw ra, 12(sp)
    li a0, 0x2008
    jal ra, ba_rd32
    slli a0, a0, 20
    srli a0, a0, 20
    sub a0, a0, s5
    lw ra, 12(sp)
    addi sp, sp, 16
    jalr zero, 0(ra)
    ba_read_ev:
    addi sp, sp, -16
    sw ra, 12(sp)
    mv t0, s5
    lui t1, 0x1
    or t0, t0, t1
    mv a0, t0
    mv a1, s2
    addi a2, zero, 4
    jal ra, ba_rd_bulk
    lhu t1, 0(s2)
    sw t1, 8(sp)
    addi t1, t1, 3
    srli t1, t1, 2
    slli t1, t1, 2
    sw t1, 4(sp)
    mv t0, s5
    addi t0, t0, 4
    lui t1, 0x1
    or t0, t0, t1
    mv a0, t0
    mv a1, s2
    lw t1, 4(sp)
    mv a2, t1
    jal ra, ba_rd_bulk
    lw t1, 4(sp)
    add t1, t1, 4
    add s5, s5, t1
    slli s5, s5, 20
    srli s5, s5, 20
    mv a1, s5
    li a0, 0x200C
    jal ra, ba_wr32
    lw ra, 12(sp)
    addi sp, sp, 16
    jalr zero, 0(ra)
    ba_wait_cc:
    addi sp, sp, -16
    sw ra, 12(sp)
    sw s8, 8(sp)
    lui s8, 0x31
    addi s8, s8, -704
    ba_wcc_poll:
    jal ra, ba_poll_b2h
    bnez a0, ba_wcc_got
    addi s8, s8, -1
    bnez s8, ba_wcc_poll
    addi a0, zero, 1
    lw s8, 8(sp)
    lw ra, 12(sp)
    addi sp, sp, 16
    jalr zero, 0(ra)
    ba_wcc_got:
    jal ra, ba_read_ev
    lbu t0, 0(s2)
    addi t1, zero, 14
    bne t0, t1, ba_wcc_bad
    lbu t0, 5(s2)
    bnez t0, ba_wcc_bad
    addi a0, zero, 0
    lw s8, 8(sp)
    lw ra, 12(sp)
    addi sp, sp, 16
    jalr zero, 0(ra)
    ba_wcc_bad:
    addi a0, zero, 1
    lw s8, 8(sp)
    lw ra, 12(sp)
    addi sp, sp, 16
    jalr zero, 0(ra)

halt:
    j halt


print_string:                # a0 = ptr
    addi sp, sp, -16
    sw ra, 12(sp)
    sw t0, 8(sp)
    sw t1, 4(sp)
ps_loop:
    lbu t1, 0(a0)
    beqz t1, ps_done
    lui t0, 0x40070
    sw t1, 0(t0)
    addi a0, a0, 1
    j ps_loop
ps_done:
    lw ra, 12(sp)
    lw t0, 8(sp)
    lw t1, 4(sp)
    addi sp, sp, 16
    ret

print_hex32:                 # a0 = word: 8 hex digits + newline
    addi sp, sp, -16
    sw ra, 12(sp)
    sw t1, 8(sp)
    sw t2, 4(sp)
    addi t2, zero, 8
    mv t1, a0
hex_digit:
    srli a0, t1, 28
    slli t1, t1, 4
    addi t0, zero, 10
    bgeu a0, t0, hex_alpha
    addi a0, a0, 0x30
    j hex_out
hex_alpha:
    addi a0, a0, 0x37
hex_out:
    lui t0, 0x40070
    sw a0, 0(t0)
    addi t2, t2, -1
    bnez t2, hex_digit
    addi a0, zero, 0x0A
    lui t0, 0x40070
    sw a0, 0(t0)
    lw ra, 12(sp)
    lw t1, 8(sp)
    lw t2, 4(sp)
    addi sp, sp, 16
    ret

uart_getc:                   # -> a0 = byte (blocks)
    lui t0, 0x40070
ug_wait:
    lw t1, 0x18(t0)
    andi t1, t1, 0x10
    bnez t1, ug_wait
    lw a0, 0(t0)
    andi a0, a0, 0xFF
    ret


    .section .rodata
    .align 2
.Ls1: .asciz "RV32 BLE Starting (BT shared bus via PIO2)\n"
.Ls2: .asciz "RV32 BLE BT-CTRL "
.Ls3: .asciz "RV32 BLE RAM-BASE "
.Ls4: .asciz "RV32 BLE HOST-READY\n"
.Ls5: .asciz "RV32 BLE RESET-OK\n"
.Ls6: .asciz "RV32 BLE ADV-OK\n"
.Ls7: .asciz "RV32 BLE LISTEN\n"
.Ls8: .asciz "RV32 BLE SCAN-OK\n"
.Ls9: .asciz "RV32 BLE SCAN-TIMEOUT\n"
.Ls10: .asciz "RV32 BLE CC-FAIL\n"
