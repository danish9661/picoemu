/* WiFi RV32 Test (RP2350 RISC-V, Hazard3 RV32IMAC).
 * Generated by gen_rv32.py - do not hand-edit (edit the generator).
 * Flash base 0x10000000 (entry via bootrom), SRAM to 0x20082000.
 */
    .text
    .globl _start
    .align 2
_start:
    lui sp, 0x20082            # SP = top of SRAM
    lui t0, 0x40070            # UART0 base
    addi t1, zero, 0x301
    sw t1, 0x30(t0)            # UARTEN|TXE|RXE

.Lr1: auipc a0, %pcrel_hi(.Ls1)
    addi a0, a0, %pcrel_lo(.Lr1)
    jal ra, print_string
    lui s0, 0x50400
    lui t1, 0x7
    addi t1, t1, 1024
    sw t1, 0xDC(s0)
    addi t1, zero, 272
    sw t1, 0x00(s0)
    addi t1, zero, 31
    sw t1, 0x10(s0)
    sw t1, 0x10(s0)
    lui t1, 0xa0044
    sw t1, 0x10(s0)
    lui t2, 0x18
    addi t2, t2, 1696
    wifi_poll:
    lw t1, 0x04(s0)
    andi t1, t1, 0x100
    beqz t1, wifi_got
    addi t2, t2, -1
    bnez t2, wifi_poll
.Lr2: auipc a0, %pcrel_hi(.Ls2)
    addi a0, a0, %pcrel_lo(.Lr2)
    jal ra, print_string
    j wifi_done
    wifi_got:
    lw t1, 0x20(s0)
.Lr3: auipc a0, %pcrel_hi(.Ls3)
    addi a0, a0, %pcrel_lo(.Lr3)
    jal ra, print_string
    mv a0, t1
    jal ra, print_hex32
    lui t2, 0xbeae0
    addi t2, t2, -275
    bne t1, t2, wifi_fail
.Lr4: auipc a0, %pcrel_hi(.Ls4)
    addi a0, a0, %pcrel_lo(.Lr4)
    jal ra, print_string
    j wifi_done
    wifi_fail:
.Lr5: auipc a0, %pcrel_hi(.Ls5)
    addi a0, a0, %pcrel_lo(.Lr5)
    jal ra, print_string
    wifi_done:
.Lr6: auipc a0, %pcrel_hi(.Ls6)
    addi a0, a0, %pcrel_lo(.Lr6)
    jal ra, print_string

halt:
    j halt


print_string:                # a0 = ptr
    addi sp, sp, -16
    sw ra, 12(sp)
    sw t0, 8(sp)
    sw t1, 4(sp)
ps_loop:
    lbu t1, 0(a0)
    beqz t1, ps_done
    lui t0, 0x40070
    sw t1, 0(t0)
    addi a0, a0, 1
    j ps_loop
ps_done:
    lw ra, 12(sp)
    lw t0, 8(sp)
    lw t1, 4(sp)
    addi sp, sp, 16
    ret

print_hex32:                 # a0 = word: 8 hex digits + newline
    addi sp, sp, -16
    sw ra, 12(sp)
    sw t1, 8(sp)
    sw t2, 4(sp)
    addi t2, zero, 8
    mv t1, a0
hex_digit:
    srli a0, t1, 28
    slli t1, t1, 4
    addi t0, zero, 10
    bgeu a0, t0, hex_alpha
    addi a0, a0, 0x30
    j hex_out
hex_alpha:
    addi a0, a0, 0x37
hex_out:
    lui t0, 0x40070
    sw a0, 0(t0)
    addi t2, t2, -1
    bnez t2, hex_digit
    addi a0, zero, 0x0A
    lui t0, 0x40070
    sw a0, 0(t0)
    lw ra, 12(sp)
    lw t1, 8(sp)
    lw t2, 4(sp)
    addi sp, sp, 16
    ret

uart_getc:                   # -> a0 = byte (blocks)
    lui t0, 0x40070
ug_wait:
    lw t1, 0x18(t0)
    andi t1, t1, 0x10
    bnez t1, ug_wait
    lw a0, 0(t0)
    andi a0, a0, 0xFF
    ret


    .section .rodata
    .align 2
.Ls1: .asciz "WiFi RV32 Test Starting (CYW43 via PIO2)\n"
.Ls2: .asciz "CYW43 TEST TIMEOUT\n"
.Ls3: .asciz "CYW43 TEST RESPONSE = "
.Ls4: .asciz "CYW43 TEST PATTERN OK\n"
.Ls5: .asciz "CYW43 TEST PATTERN FAIL\n"
.Ls6: .asciz "WiFi RV32 Test Complete!\n"
