/* ETH DHCP RV32 Test (RP2350 RISC-V, Hazard3 RV32IMAC).
 * Generated by gen_eth_dhcp.py - do not hand-edit (edit the generator).
 * Flash base 0x10000000 (entry via bootrom), SRAM to 0x20082000.
 */
    .text
    .globl _start
    .align 2
_start:
    lui sp, 0x20082            # SP = top of SRAM
    lui t0, 0x40070            # UART0 base
    addi t1, zero, 0x301
    sw t1, 0x30(t0)            # UARTEN|TXE|RXE
.Lr1: auipc a0, %pcrel_hi(.Ls1)
    addi a0, a0, %pcrel_lo(.Lr1)
    jal ra, rv_print_string
    lui t0, 0x40080            # SPI0 base
    addi t1, zero, 7
    sw t1, 0(t0)
    addi t1, zero, 2
    sw t1, 0x10(t0)
    sw t1, 0x04(t0)
    lui t0, 0xD0000
    addi t0, t0, 0x24          # SIO OE_SET
    lui t1, 0x20                # GPIO17 mask 0x20000
    sw t1, 0(t0)
    lui t0, 0xD0000
    addi t0, t0, 0x14          # SIO OUT_SET
    sw t1, 0(t0)
    jal ra, rv_spi_cs_lo
    addi a0, zero, 0
    jal ra, rv_spi_xfer
    addi a0, zero, 0x39
    jal ra, rv_spi_xfer
    addi a0, zero, 0
    jal ra, rv_spi_xfer
    addi a0, zero, 0xFF
    jal ra, rv_spi_xfer
    mv s0, a0
    jal ra, rv_spi_cs_hi
    addi t0, zero, 4
    bne s0, t0, rv_ver_fail
    jal ra, rv_spi_cs_lo          # SHAR0..5 = frame SRC MAC
    addi a0, zero, 0
    jal ra, rv_spi_xfer
    addi a0, zero, 9         # SHAR0
    jal ra, rv_spi_xfer
    addi a0, zero, 0x04        # common write
    jal ra, rv_spi_xfer
    addi a0, zero, 2         # MAC byte 0
    jal ra, rv_spi_xfer
    jal ra, rv_spi_cs_hi
    jal ra, rv_spi_cs_lo
    addi a0, zero, 0
    jal ra, rv_spi_xfer
    addi a0, zero, 10         # SHAR1
    jal ra, rv_spi_xfer
    addi a0, zero, 0x04        # common write
    jal ra, rv_spi_xfer
    addi a0, zero, 17         # MAC byte 1
    jal ra, rv_spi_xfer
    jal ra, rv_spi_cs_hi
    jal ra, rv_spi_cs_lo
    addi a0, zero, 0
    jal ra, rv_spi_xfer
    addi a0, zero, 11         # SHAR2
    jal ra, rv_spi_xfer
    addi a0, zero, 0x04        # common write
    jal ra, rv_spi_xfer
    addi a0, zero, 34         # MAC byte 2
    jal ra, rv_spi_xfer
    jal ra, rv_spi_cs_hi
    jal ra, rv_spi_cs_lo
    addi a0, zero, 0
    jal ra, rv_spi_xfer
    addi a0, zero, 12         # SHAR3
    jal ra, rv_spi_xfer
    addi a0, zero, 0x04        # common write
    jal ra, rv_spi_xfer
    addi a0, zero, 51         # MAC byte 3
    jal ra, rv_spi_xfer
    jal ra, rv_spi_cs_hi
    jal ra, rv_spi_cs_lo
    addi a0, zero, 0
    jal ra, rv_spi_xfer
    addi a0, zero, 13         # SHAR4
    jal ra, rv_spi_xfer
    addi a0, zero, 0x04        # common write
    jal ra, rv_spi_xfer
    addi a0, zero, 68         # MAC byte 4
    jal ra, rv_spi_xfer
    jal ra, rv_spi_cs_hi
    jal ra, rv_spi_cs_lo
    addi a0, zero, 0
    jal ra, rv_spi_xfer
    addi a0, zero, 14         # SHAR5
    jal ra, rv_spi_xfer
    addi a0, zero, 0x04        # common write
    jal ra, rv_spi_xfer
    addi a0, zero, 98         # MAC byte 5
    jal ra, rv_spi_xfer
    jal ra, rv_spi_cs_hi
    jal ra, rv_spi_cs_lo
    addi a0, zero, 0
    jal ra, rv_spi_xfer
    addi a0, zero, 0
    jal ra, rv_spi_xfer
    addi a0, zero, 0x0C
    jal ra, rv_spi_xfer
    addi a0, zero, 4
    jal ra, rv_spi_xfer
    jal ra, rv_spi_cs_hi
    jal ra, rv_spi_cs_lo
    addi a0, zero, 0
    jal ra, rv_spi_xfer
    addi a0, zero, 1
    jal ra, rv_spi_xfer
    addi a0, zero, 0x0C
    jal ra, rv_spi_xfer
    addi a0, zero, 1
    jal ra, rv_spi_xfer
    jal ra, rv_spi_cs_hi
    jal ra, rv_spi_cs_lo
    addi a0, zero, 0
    jal ra, rv_spi_xfer
    addi a0, zero, 3
    jal ra, rv_spi_xfer
    addi a0, zero, 8
    jal ra, rv_spi_xfer
    addi a0, zero, 0xFF
    jal ra, rv_spi_xfer
    mv s0, a0
    jal ra, rv_spi_cs_hi
    addi t0, zero, 0x42
    bne s0, t0, rv_open_fail
.Lr2: auipc a0, %pcrel_hi(.Ls2)
    addi a0, a0, %pcrel_lo(.Lr2)
    jal ra, rv_print_string
    jal ra, rv_dhcp_run
    j rv_halt
rv_ver_fail:
.Lr3: auipc a0, %pcrel_hi(.Ls3)
    addi a0, a0, %pcrel_lo(.Lr3)
    jal ra, rv_print_string
    j rv_fail
rv_open_fail:
.Lr4: auipc a0, %pcrel_hi(.Ls4)
    addi a0, a0, %pcrel_lo(.Lr4)
    jal ra, rv_print_string
    j rv_fail
rv_fail:
.Lr5: auipc a0, %pcrel_hi(.Ls5)
    addi a0, a0, %pcrel_lo(.Lr5)
    jal ra, rv_print_string
rv_halt:
    j rv_halt
rv_spi_xfer:
    addi sp, sp, -16
    sw ra, 12(sp)
    lui t0, 0x40080
    sw a0, 8(t0)
    lw a0, 8(t0)
    andi a0, a0, 0xFF
    lw ra, 12(sp)
    addi sp, sp, 16
    ret
rv_spi_cs_lo:
    addi sp, sp, -16
    sw ra, 12(sp)
    lui t0, 0xD0000
    addi t0, t0, 0x18          # SIO OUT_CLR (wreg-style: no sw-off)
    lui t1, 0x20
    sw t1, 0(t0)
    lw ra, 12(sp)
    addi sp, sp, 16
    ret
rv_spi_cs_hi:
    addi sp, sp, -16
    sw ra, 12(sp)
    lui t0, 0xD0000
    addi t0, t0, 0x14          # SIO OUT_SET (wreg-style)
    lui t1, 0x20
    sw t1, 0(t0)
    lw ra, 12(sp)
    addi sp, sp, 16
    ret
rv_dhcp_run:
    addi sp, sp, -32
    sw ra, 28(sp)
    sw s0, 24(sp)
    sw s1, 20(sp)
    sw s2, 16(sp)
.Lr6: auipc a0, %pcrel_hi(disc_blob)
    addi a0, a0, %pcrel_lo(.Lr6)
    addi a1, zero, 342
    jal ra, rv_macraw_send
    jal ra, rv_wait_offer          # a0 = msg type (2/5/0)
    addi t0, zero, 2
    bne a0, t0, rv_offer_fail
.Lr7: auipc a0, %pcrel_hi(.Ls6)
    addi a0, a0, %pcrel_lo(.Lr7)
    jal ra, rv_print_string
    jal ra, rv_print_ip
.Lr8: auipc a0, %pcrel_hi(.Ls8)
    addi a0, a0, %pcrel_lo(.Lr8)
    jal ra, rv_print_string
.Lr9: auipc a0, %pcrel_hi(req_blob)
    addi a0, a0, %pcrel_lo(.Lr9)
    jal ra, rv_patch_request      # a0 = TXBUF stamped copy
    addi a1, zero, 342
    jal ra, rv_macraw_send
    jal ra, rv_wait_offer
    addi t0, zero, 5
    bne a0, t0, rv_ack_fail
.Lr10: auipc a0, %pcrel_hi(.Ls7)
    addi a0, a0, %pcrel_lo(.Lr10)
    jal ra, rv_print_string
    jal ra, rv_print_ip
.Lr11: auipc a0, %pcrel_hi(.Ls8)
    addi a0, a0, %pcrel_lo(.Lr11)
    jal ra, rv_print_string
.Lr12: auipc a0, %pcrel_hi(.Ls9)
    addi a0, a0, %pcrel_lo(.Lr12)
    jal ra, rv_print_string
    lw ra, 28(sp)
    lw s0, 24(sp)
    lw s1, 20(sp)
    lw s2, 16(sp)
    addi sp, sp, 32
    ret
rv_offer_fail:
.Lr13: auipc a0, %pcrel_hi(.Ls10)
    addi a0, a0, %pcrel_lo(.Lr13)
    jal ra, rv_print_string
    j rv_dhcp_fail_ret
rv_ack_fail:
.Lr14: auipc a0, %pcrel_hi(.Ls11)
    addi a0, a0, %pcrel_lo(.Lr14)
    jal ra, rv_print_string
rv_dhcp_fail_ret:
    lw ra, 28(sp)
    lw s0, 24(sp)
    lw s1, 20(sp)
    lw s2, 16(sp)
    addi sp, sp, 32
    ret
rv_macraw_send:
    addi sp, sp, -32
    sw ra, 28(sp)
    sw s0, 24(sp)
    sw s1, 20(sp)
    sw s2, 16(sp)
    mv s0, a0
    mv s1, a1
    mv s2, a1                # s2 = len (TX_WR below)
    jal ra, rv_spi_cs_lo
    addi a0, zero, 0
    jal ra, rv_spi_xfer
    addi a0, zero, 0
    jal ra, rv_spi_xfer
    addi a0, zero, 0x14        # (BSB_TX<<3)|VDM-write: bsb=2,rw=1,om=0
    jal ra, rv_spi_xfer
rv_ms_loop:
    beqz s1, rv_ms_txwr
    lbu a0, 0(s0)
    jal ra, rv_spi_xfer
    addi s0, s0, 1
    addi s1, s1, -1
    j rv_ms_loop
rv_ms_txwr:
    jal ra, rv_spi_cs_hi
    # TX_WR hi+lo in ONE CS frame (VDM auto-increment 0x24->0x25).
    # Split hi/lo frames risk a stale-echo header on the 2nd frame.
    jal ra, rv_spi_cs_lo
    addi a0, zero, 0
    jal ra, rv_spi_xfer
    addi a0, zero, 0x24        # TX_WR0 = HIGH byte
    jal ra, rv_spi_xfer
    addi a0, zero, 0x0C
    jal ra, rv_spi_xfer
    srli a0, s2, 8             # hi DIRECT from s-reg (t-regs die in jal)
    jal ra, rv_spi_xfer
    andi a0, s2, 0xFF          # lo DIRECT from s-reg (VDM incr -> 0x25)
    jal ra, rv_spi_xfer
    jal ra, rv_spi_cs_hi
    jal ra, rv_spi_cs_lo          # Sn_CR = SEND
    addi a0, zero, 0
    jal ra, rv_spi_xfer
    addi a0, zero, 1
    jal ra, rv_spi_xfer
    addi a0, zero, 0x0C
    jal ra, rv_spi_xfer
    addi a0, zero, 0x20
    jal ra, rv_spi_xfer
    jal ra, rv_spi_cs_hi
    lw ra, 28(sp)
    lw s0, 24(sp)
    lw s1, 20(sp)
    lw s2, 16(sp)
    addi sp, sp, 32
    ret
rv_wait_offer:
    addi sp, sp, -32
    sw ra, 28(sp)
    sw s0, 24(sp)
    sw s1, 20(sp)
    sw s2, 16(sp)
    lui s2, 0x800              # bound = 0x8000000 poll iters
                               # (~134M: the RV32 SPI word path costs
                               # ~4x per xfer vs ARM PL022 FIFO, so the
                               # old 0x2000000 (~33M... comment below)
                               # bound expired before the python peer
                               # answered; M0/M33 keep 33M (proven).
rv_wo_poll:
    jal ra, rv_spi_cs_lo
    addi a0, zero, 0
    jal ra, rv_spi_xfer
    addi a0, zero, 2           # S_IR
    jal ra, rv_spi_xfer
    addi a0, zero, 8           # (1<<3)|0 read
    jal ra, rv_spi_xfer
    addi a0, zero, 0xFF
    jal ra, rv_spi_xfer
    andi s0, a0, 4            # s0: t0/t1 BOTH die in rv_spi_cs_hi
                              # (lui t0/sw + lui t1/sw); s0 is
                              # callee-saved (sw/lw in prologue).
    jal ra, rv_spi_cs_hi
    bnez s0, rv_wo_got
    addi s2, s2, -1
    bnez s2, rv_wo_poll
    addi a0, zero, 0
    j rv_wo_done
rv_wo_got:
    jal ra, rv_spi_cs_lo          # RX read from addr 0, BSB_RX
    addi a0, zero, 0
    jal ra, rv_spi_xfer
    addi a0, zero, 0
    jal ra, rv_spi_xfer
    addi a0, zero, 0x18        # (3<<3)|0
    jal ra, rv_spi_xfer
    addi a0, zero, 0xFF
    jal ra, rv_spi_xfer
    mv s0, a0                  # len hi
    addi a0, zero, 0xFF
    jal ra, rv_spi_xfer
    mv s1, a0                  # len lo
    slli s0, s0, 8
    add s0, s0, s1             # s0 = stored len (frame + 2)
    addi s0, s0, -2            # s0 = frame len (prefix includes self)
    lui t0, 0x20042
    addi t0, t0, -0x200        # RXBUF 0x20041E00
    mv s1, t0                  # dst cursor
    mv s2, s0                  # remaining
rv_rx_copy:
    beqz s2, rv_rx_done
    addi a0, zero, 0xFF
    jal ra, rv_spi_xfer
    sb a0, 0(s1)
    addi s1, s1, 1
    addi s2, s2, -1
    j rv_rx_copy
rv_rx_done:
    jal ra, rv_spi_cs_hi
    jal ra, rv_spi_cs_lo          # Sn_CR = RECV consume
    addi a0, zero, 0
    jal ra, rv_spi_xfer
    addi a0, zero, 1
    jal ra, rv_spi_xfer
    addi a0, zero, 0x0C
    jal ra, rv_spi_xfer
    addi a0, zero, 0x40
    jal ra, rv_spi_xfer
    jal ra, rv_spi_cs_hi
    jal ra, rv_parse_offer        # a0 = msgtype or 0
    bnez a0, rv_wo_done
    lui s2, 0x100              # re-poll budget (same scale as entry)
    j rv_wo_poll
rv_wo_done:
    lw ra, 28(sp)
    lw s0, 24(sp)
    lw s1, 20(sp)
    lw s2, 16(sp)
    addi sp, sp, 32
    ret
rv_parse_offer:
    lui t0, 0x20042
    addi t0, t0, -0x200      # RXBUF 0x20041E00
    lbu t1, 12(t0)             # ethertype hi: expect 0x08
    addi t2, zero, 8
    bne t1, t2, rv_po_no
    lbu t1, 13(t0)             # ethertype lo: expect 0x00
    bnez t1, rv_po_no
    addi t0, t0, 46            # xid byte0 at RXBUF+46 (bootp+4);
                               # t0 is still RXBUF here (the lbu
                               # above use offsets, unlike ARM which
                               # stepped r0 to RXBUF+14 first).
    lbu t1, 0(t0)
    xori t2, t1, 192
    bnez t2, rv_po_no
    lbu t1, 1(t0)
    xori t2, t1, 178
    bnez t2, rv_po_no
    addi t0, t0, 12            # bootp+16 yiaddr
    lui t1, 0x20000
    addi t1, t1, 0x100         # YIP 0x20000100
    lbu t2, 0(t0)
    sb t2, 0(t1)
    lbu t2, 1(t0)
    sb t2, 1(t1)
    lbu t2, 2(t0)
    sb t2, 2(t1)
    lbu t2, 3(t0)
    sb t2, 3(t1)
    addi t0, t0, 220           # bootp+236 magic
    lbu t1, 0(t0)
    addi t2, zero, 99
    bne t1, t2, rv_po_no
    lbu t1, 1(t0)
    xori t2, t1, 130
    bnez t2, rv_po_no
    addi t0, t0, 4             # bootp+240 options
    lui t1, 0x20000
    addi t1, t1, 0x104         # SIP 0x20000104
    addi t2, zero, 0           # msgtype
rv_opt_loop:
    lbu t3, 0(t0)
    addi t4, zero, 255
    beq t3, t4, rv_opt_done
    addi t4, zero, 53
    bne t3, t4, rv_opt_not53
    lbu t2, 2(t0)
    j rv_po_opt_adv
rv_opt_not53:
    addi t4, zero, 54
    bne t3, t4, rv_po_opt_adv
    lbu t3, 2(t0)
    sb t3, 0(t1)
    lbu t3, 3(t0)
    sb t3, 1(t1)
    lbu t3, 4(t0)
    sb t3, 2(t1)
    lbu t3, 5(t0)
    sb t3, 3(t1)
rv_po_opt_adv:
    lbu t3, 1(t0)
    add t0, t0, t3
    addi t0, t0, 2
    j rv_opt_loop
rv_opt_done:
    mv a0, t2
    ret
rv_po_no:
    addi a0, zero, 0
    ret
rv_patch_request:
    mv t5, a0                  # src = req blob
    lui t0, 0x20042
    addi t0, t0, -0x400        # TXBUF dst
    mv t6, t0
    addi t1, zero, 342  # len
rv_pr_copy:
    beqz t1, rv_pr_stamp
    lbu t2, 0(t5)
    sb t2, 0(t6)
    addi t5, t5, 1
    addi t6, t6, 1
    addi t1, t1, -1
    j rv_pr_copy
rv_pr_stamp:
    lui t1, 0x20000
    addi t1, t1, 0x100         # YIP 0x20000100
    addi t0, t0, 287           # TXBUF+287 requested-IP value
    lbu t2, 0(t1)
    sb t2, 0(t0)
    lbu t2, 1(t1)
    sb t2, 1(t0)
    lbu t2, 2(t1)
    sb t2, 2(t0)
    lbu t2, 3(t1)
    sb t2, 3(t0)
    addi t0, t0, 6             # TXBUF+293 server-IP value
    addi t1, t1, 4             # SIP 0x20000104
    lbu t2, 0(t1)
    sb t2, 0(t0)
    lbu t2, 1(t1)
    sb t2, 1(t0)
    lbu t2, 2(t1)
    sb t2, 2(t0)
    lbu t2, 3(t1)
    sb t2, 3(t0)
    lui t0, 0x20042
    addi t0, t0, -0x400        # return TXBUF in a0 for macraw_send
    mv a0, t0
    ret
rv_print_string:                # a0 = ptr
    addi sp, sp, -16
    sw ra, 12(sp)
    sw t0, 8(sp)
    sw t1, 4(sp)
rv_ps_loop:
    lbu t1, 0(a0)
    beqz t1, rv_ps_done
    lui t0, 0x40070
    sw t1, 0(t0)
    addi a0, a0, 1
    j rv_ps_loop
rv_ps_done:
    lw ra, 12(sp)
    lw t0, 8(sp)
    lw t1, 4(sp)
    addi sp, sp, 16
    ret
rv_print_ip:                    # prints YIP a.b.c.d (no newline)
    addi sp, sp, -32
    sw ra, 28(sp)
    sw s0, 24(sp)
    lui s0, 0x20000
    addi s0, s0, 0x100         # YIP
    addi t6, zero, 4           # octets left
rv_ip_oct:
    lbu a0, 0(s0)
    jal ra, rv_print_u8
    addi t6, t6, -1
    beqz t6, rv_ip_done
    addi a0, zero, 46          # '.'
    lui t0, 0x40070
    sw a0, 0(t0)
    addi s0, s0, 1
    j rv_ip_oct
rv_ip_done:
    lw ra, 28(sp)
    lw s0, 24(sp)
    addi sp, sp, 32
    ret
rv_print_u8:                    # a0 = 0..255 -> decimal, no leading zeros
    addi sp, sp, -32
    sw ra, 28(sp)
    sw s0, 24(sp)
    sw s1, 20(sp)
    sw s2, 16(sp)
    mv s0, a0                  # value
    addi s1, zero, 0           # printed-any flag
    addi t0, zero, 100
    jal ra, rv_print_digit        # (s0=value, s1=flag, t0=div)
    addi t0, zero, 10
    jal ra, rv_print_digit
    addi t0, zero, 1
    jal ra, rv_print_digit
    lw ra, 28(sp)
    lw s0, 24(sp)
    lw s1, 20(sp)
    lw s2, 16(sp)
    addi sp, sp, 32
    ret
rv_print_digit:                 # s0=value t0=div s1=flag -> UART digit
    mv t1, s0
    addi t2, zero, 0           # quotient
rv_dg_loop:
    bltu t1, t0, rv_dg_done
    sub t1, t1, t0
    addi t2, t2, 1
    j rv_dg_loop
rv_dg_done:
    mv s0, t1                  # remainder back to value
    addi t3, zero, 1
    beq t0, t3, rv_dg_show        # ones always print
    bnez t2, rv_dg_show
    bnez s1, rv_dg_show0          # tens prints 0 if hundreds did
    ret
rv_dg_show0:
    addi t2, zero, 0
rv_dg_show:
    addi t2, t2, 48
    lui t4, 0x40070
    sw t2, 0(t4)
    addi s1, zero, 1
    ret

    .section .rodata
    .align 2
.Ls1: .asciz "ETH DHCP-START\n"
.Ls2: .asciz "ETH MACRAW-OK\n"
.Ls3: .asciz "ETH FAIL VERSION\n"
.Ls4: .asciz "ETH FAIL OPEN\n"
.Ls5: .asciz "ETH FAIL\n"
.Ls6: .asciz "ETH OFFER IP="
.Ls7: .asciz "ETH IP="
.Ls8: .asciz "\n"
.Ls9: .asciz "ETH DONE\n"
.Ls10: .asciz "ETH FAIL OFFER-TIMEOUT\n"
.Ls11: .asciz "ETH FAIL ACK-TIMEOUT\n"
disc_blob:  # DISCOVER 342B
    .byte 255, 255, 255, 255, 255, 255, 2, 17, 34, 51, 68, 98
    .byte 8, 0, 69, 0, 1, 72, 17, 34, 0, 0, 64, 17
    .byte 104, 132, 0, 0, 0, 0, 255, 255, 255, 255, 0, 68
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    .byte 0, 0, 0, 0, 0, 0
req_blob:   # REQUEST 342B
    .byte 255, 255, 255, 255, 255, 255, 2, 17, 34, 51, 68, 98
    .byte 8, 0, 69, 0, 1, 72, 51, 68, 0, 0, 64, 17
    .byte 70, 98, 0, 0, 0, 0, 255, 255, 255, 255, 0, 68
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    .byte 0, 0, 0, 0, 0, 0
