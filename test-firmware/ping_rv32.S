/* Ping Test (RP2350 RISC-V, Hazard3 RV32IMAC).
 * Generated by gen_rv32.py - do not hand-edit (edit the generator).
 * Flash base 0x10000000 (entry via bootrom), SRAM to 0x20082000.
 */
    .text
    .globl _start
    .align 2
_start:
    lui sp, 0x20082            # SP = top of SRAM
    lui t0, 0x40070            # UART0 base
    addi t1, zero, 0x301
    sw t1, 0x30(t0)            # UARTEN|TXE|RXE

.Lr1: auipc a0, %pcrel_hi(.Ls1)
    addi a0, a0, %pcrel_lo(.Lr1)
    jal ra, print_string
    lui s0, 0x50400
    lui s1, 0x50400
    addi s1, s1, 16
    lui t1, 0x7
    addi t1, t1, 1024
    sw t1, 0xDC(s0)
    addi t1, zero, 272
    sw t1, 0x00(s0)
    addi t1, zero, 31
    sw t1, 0x10(s0)
    sw t1, 0x10(s0)
    lui t1, 0xa0044
    sw t1, 0x10(s0)
    lw t1, 0x20(s0)
    addi t1, zero, 272
    sw t1, 0x00(s0)
    addi t1, zero, 31
    sw t1, 0x10(s0)
    sw t1, 0x10(s0)
    lui t1, 0xa0044
    sw t1, 0x10(s0)
    lw t1, 0x20(s0)
    addi t1, zero, 272
    sw t1, 0x00(s0)
    addi t1, zero, 511
    sw t1, 0x10(s0)
    addi t1, zero, 0
    sw t1, 0x10(s0)
    lui t1, 0x44000
    addi t1, t1, 224
    sw t1, 0x10(s0)
    lui t1, 0x4400c
    addi t1, t1, -1025
    sw t1, 0(s1)
    lui t1, 0x20
    addi t1, t1, 14
    sw t1, 0(s1)
    lui t1, 0x40
    sw t1, 0(s1)
    lui t1, 0x2
    sw t1, 0(s1)
    addi t1, zero, 530
    sw t1, 0(s1)
    lui t1, 0x34568
    addi t1, t1, -2047
    sw t1, 0(s1)
    lui t1, 0xdeadc
    addi t1, t1, -273
    sw t1, 0(s1)
    lui t1, 0xcafe1
    addi t1, t1, -2048
    sw t1, 0(s1)
    lui t1, 0x45000
    addi t1, t1, 36
    sw t1, 0(s1)
    addi t1, zero, 0
    sw t1, 0(s1)
    lui t1, 0x4001f
    addi t1, t1, 291
    sw t1, 0(s1)
    lui t1, 0xc0a80
    addi t1, t1, 1124
    sw t1, 0(s1)
    lui t1, 0xc0a80
    addi t1, t1, 1025
    sw t1, 0(s1)
    lui t1, 0x8008
    addi t1, t1, -224
    sw t1, 0(s1)
    lui t1, 0x12340
    addi t1, t1, 1
    sw t1, 0(s1)
    lui t1, 0xaabbd
    addi t1, t1, -803
    sw t1, 0(s1)
    lui t1, 0xeeff0
    addi t1, t1, 17
    sw t1, 0(s1)
    addi t1, zero, 272
    sw t1, 0x00(s0)
    addi t1, zero, 511
    sw t1, 0x10(s0)
    addi t1, zero, 0
    sw t1, 0x10(s0)
    lui t1, 0x10
    addi t1, t1, 96
    sw t1, 0x10(s0)
    lui t2, 0x31
    addi t2, t2, -704
    ping_poll:
    lw t1, 0x04(s0)
    andi t1, t1, 0x100
    beqz t1, ping_got
    addi t2, t2, -1
    bnez t2, ping_poll
.Lr2: auipc a0, %pcrel_hi(.Ls2)
    addi a0, a0, %pcrel_lo(.Lr2)
    jal ra, print_string
    j ping_done
    ping_got:
    lw t1, 0x20(s0)
.Lr3: auipc a0, %pcrel_hi(.Ls3)
    addi a0, a0, %pcrel_lo(.Lr3)
    jal ra, print_string
    mv a0, t1
    jal ra, print_hex32
    lui t2, 0x4400c
    addi t2, t2, -1025
    bne t1, t2, ping_fail
.Lr4: auipc a0, %pcrel_hi(.Ls4)
    addi a0, a0, %pcrel_lo(.Lr4)
    jal ra, print_string
    j ping_done
    ping_fail:
.Lr5: auipc a0, %pcrel_hi(.Ls5)
    addi a0, a0, %pcrel_lo(.Lr5)
    jal ra, print_string
    ping_done:
.Lr6: auipc a0, %pcrel_hi(.Ls6)
    addi a0, a0, %pcrel_lo(.Lr6)
    jal ra, print_string

halt:
    j halt


print_string:                # a0 = ptr
    addi sp, sp, -16
    sw ra, 12(sp)
    sw t0, 8(sp)
    sw t1, 4(sp)
ps_loop:
    lbu t1, 0(a0)
    beqz t1, ps_done
    lui t0, 0x40070
    sw t1, 0(t0)
    addi a0, a0, 1
    j ps_loop
ps_done:
    lw ra, 12(sp)
    lw t0, 8(sp)
    lw t1, 4(sp)
    addi sp, sp, 16
    ret

print_hex32:                 # a0 = word: 8 hex digits + newline
    addi sp, sp, -16
    sw ra, 12(sp)
    sw t1, 8(sp)
    sw t2, 4(sp)
    addi t2, zero, 8
    mv t1, a0
hex_digit:
    srli a0, t1, 28
    slli t1, t1, 4
    addi t0, zero, 10
    bgeu a0, t0, hex_alpha
    addi a0, a0, 0x30
    j hex_out
hex_alpha:
    addi a0, a0, 0x37
hex_out:
    lui t0, 0x40070
    sw a0, 0(t0)
    addi t2, t2, -1
    bnez t2, hex_digit
    addi a0, zero, 0x0A
    lui t0, 0x40070
    sw a0, 0(t0)
    lw ra, 12(sp)
    lw t1, 8(sp)
    lw t2, 4(sp)
    addi sp, sp, 16
    ret

uart_getc:                   # -> a0 = byte (blocks)
    lui t0, 0x40070
ug_wait:
    lw t1, 0x18(t0)
    andi t1, t1, 0x10
    bnez t1, ug_wait
    lw a0, 0(t0)
    andi a0, a0, 0xFF
    ret


    .section .rodata
    .align 2
.Ls1: .asciz "RV32 Ping Test Starting (ICMP via PIO2)\n"
.Ls2: .asciz "RV32 PING TIMEOUT\n"
.Ls3: .asciz "RV32 PING RESPONSE = "
.Ls4: .asciz "RV32 PING PASS\n"
.Ls5: .asciz "RV32 PING FAIL\n"
.Ls6: .asciz "RV32 Ping Test Complete!\n"
